## conf/layer.conf
```bitbake
# We have a conf and classes directory, add to BBPATH
BBPATH .= ":${LAYERDIR}"

# We have recipes-* directories, add to BBFILES
BBFILES += "${LAYERDIR}/recipes-*/*/*.bb \
	${LAYERDIR}/recipes-*/*/*.bbappend"

BBFILE_COLLECTIONS += "tools"
BBFILE_PATTERN_tools = "^${LAYERDIR}/"
BBFILE_PRIORITY_tools = "5"

# This should only be incremented on significant changes that will
# cause compatibility issues with other layers
LAYERVERSION_znp-layer = "1"

LAYERSERIES_COMPAT_tools = "dunfell kirkstone"
```
